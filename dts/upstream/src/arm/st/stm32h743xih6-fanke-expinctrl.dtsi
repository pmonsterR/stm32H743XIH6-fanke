#include <dt-bindings/pinctrl/stm32-pinfunc.h>

&pinctrl {
        fanke_usart1_pins: fanke_usart1_def {
		pins1 {
			pinmux = <STM32_PINMUX('A', 9, AF7)>; /* USART1_TX */
			bias-disable;
			drive-push-pull;
			slew-rate = <0>;
		};
		pins2 {
			pinmux = <STM32_PINMUX('A', 10, AF7)>; /* USART1_RX */
			bias-disable;
		};
	};
};

