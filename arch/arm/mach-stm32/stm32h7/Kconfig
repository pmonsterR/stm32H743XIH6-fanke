## arch/arm/mach-stm32/stm32h7/Kconfig
```kconfig
if STM32H7

config TARGET_STM32H743_DISCO
	bool "STM32H743 Discovery board"

config TARGET_STM32H743_EVAL
	bool "STM32H743 Evaluation board"

config TARGET_STM32H750_ART_PI
	bool "STM32H750 ART Pi board"

config TARGET_STM32H743_FANKE
	bool "STM32H743 FANKE board"

source "board/st/stm32h743-eval/Kconfig"
source "board/st/stm32h743-disco/Kconfig"
source "board/st/stm32h750-art-pi/Kconfig"
source "board/st/stm32h743xih6-fanke/Kconfig"

endif
```

## board/st/stm32h743xih6-fanke/Kconfig
```kconfig
if TARGET_STM32H743_FANKE

config SYS_BOARD
	default "stm32h743xih6-fanke"

config SYS_VENDOR
	default "st"

config SYS_SOC
	default "stm32h7"

config SYS_CONFIG_NAME
	default "stm32h743xih6-fanke"

endif
```

## configs/stm32h743xih6-fanke_defconfig
```kconfig
CONFIG_ARM=y
CONFIG_ARCH_STM32=y
CONFIG_TEXT_BASE=0x08000000
CONFIG_SYS_MALLOC_LEN=0x100000
CONFIG_NR_DRAM_BANKS=4
CONFIG_HAS_CUSTOM_SYS_INIT_SP_ADDR=y
CONFIG_CUSTOM_SYS_INIT_SP_ADDR=0x24040000
CONFIG_ENV_SIZE=0x2000
CONFIG_DEFAULT_DEVICE_TREE="st/stm32h743xih6-fanke"
CONFIG_OF_LIBFDT_OVERLAY=y
CONFIG_SYS_LOAD_ADDR=0xc0400000
CONFIG_STM32H7=y
CONFIG_TARGET_STM32H743_FANKE=y
CONFIG_DISTRO_DEFAULTS=y
CONFIG_BOOTDELAY=3
CONFIG_AUTOBOOT_KEYED=y
CONFIG_AUTOBOOT_PROMPT="Hit ENTER in %d seconds to enter u-boot console.\n"
CONFIG_AUTOBOOT_STOP_STR="\r"
CONFIG_DEFAULT_FDT_FILE="stm32h743xih6-fanke"
CONFIG_SYS_CBSIZE=256
CONFIG_SYS_PBSIZE=282
# CONFIG_DISPLAY_CPUINFO is not set
CONFIG_SYS_PROMPT="STM32H743XIH6 > "
CONFIG_CMD_GPT=y
CONFIG_CMD_MMC=y
# CONFIG_CMD_SETEXPR is not set
CONFIG_CMD_CACHE=y
CONFIG_CMD_TIMER=y
CONFIG_CMD_EXT4_WRITE=y
CONFIG_CMD_SF_TEST=y
# CONFIG_ISO_PARTITION is not set
CONFIG_OF_CONTROL=y
CONFIG_SYS_RELOC_GD_ENV_ADDR=y
CONFIG_NO_NET=y
CONFIG_STM32_SDMMC2=y
CONFIG_MTD=y
CONFIG_DM_SPI_FLASH=y
CONFIG_SPI_FLASH=y
CONFIG_SPI_FLASH_WINBOND=y
CONFIG_SPI_FLASH_MTD=y
# CONFIG_PINCTRL_FULL is not set
CONFIG_DM_REGULATOR=y
CONFIG_DM_REGULATOR_FIXED=y
CONFIG_SPI=y
CONFIG_DM_SPI=y
CONFIG_STM32_QSPI=y
```
